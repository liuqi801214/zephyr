## boards/arm/rtl8752htv_evb/rtl8752htv_evb_defconfig
```kconfig
CONFIG_SOC_SERIES_RTL8752H=y
CONFIG_SOC_RTL8752HTV=y
CONFIG_BOARD_RTL8752HTV_EVB=y

# DISASSEMBLY
CONFIG_OUTPUT_DISASSEMBLY=y

# link application into the the flash partition selected by the zephyr,code-partition property in /chosen in devicetree
CONFIG_USE_DT_CODE_PARTITION=y
CONFIG_CODE_DATA_RELOCATION=y
CONFIG_REALTEK_BT_CONTROLLER_STACK_SIZE=2560
# Save DataRAM for APP


# For Debug
CONFIG_DEBUG_OPTIMIZATIONS=y
CONFIG_SYS_HEAP_RUNTIME_STATS=y

CONFIG_PINCTRL=y
CONFIG_CLOCK_CONTROL=y

# Console Driver
CONFIG_CONSOLE=y
CONFIG_UART_CONSOLE=y

# UART Driver
CONFIG_SERIAL=y
CONFIG_UART_INTERRUPT_DRIVEN=y
# CONFIG_UART_ASYNC_API=y
```
